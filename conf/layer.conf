## conf/layer.conf
```bitbake
# We have a conf and classes directory, add to BBPATH
BBPATH .= ":${LAYERDIR}"

# We have a packages directory, add to BBFILES
BBFILES += "${LAYERDIR}/recipes-*/*/*.bb \
            ${LAYERDIR}/recipes-*/*/*.bbappend"

BBFILE_COLLECTIONS += "elnico-sqm4"
BBFILE_PATTERN_elnico-sqm4 := "^${LAYERDIR}/"
BBFILE_PRIORITY_elnico-sqm4 = "7"

# Let us add layer-specific bbappends which are only applied when that
# layer is included in our configuration
BBFILES += "${@' '.join('${LAYERDIR}/%s/recipes*/*/*.bbappend' % layer \
               for layer in BBFILE_COLLECTIONS.split())}"
# Add layer-specific bb files too
BBFILES += "${@' '.join('${LAYERDIR}/%s/recipes*/*/*.bb' % layer \
               for layer in BBFILE_COLLECTIONS.split())}"

LAYERDEPENDS_elnico-sqm4 = "core fsl-arm"
```

## conf/machine/sqm4sx6-eb.conf
```bitbake
#@TYPE: Machine
#@NAME: Elnico SQM4-SX6-EasyBoard
#@SOC: i.MX6SX
#@DESCRIPTION: Machine configuration for Elnico SQM4-SX6-EasyBoard
#@MAINTAINER: Petr Kubiznak <kubiznak.petr@elnico.cz>

MACHINEOVERRIDES =. "mx6:mx6sx:"

require conf/machine/include/imx-base.inc
require conf/machine/include/tune-cortexa9.inc

PREFERRED_PROVIDER_virtual/kernel ?= "linux-fslc-imx"
PREFERRED_VERSION_linux-fslc-imx ?= "4.1-2.0%"

KERNEL_DEVICETREE = "sqm4sx6-eb.dtb sqm4sx6-eb-m4.dtb"

PREFERRED_PROVIDER_u-boot = "u-boot-imx-elnico"
PREFERRED_PROVIDER_virtual/bootloader = "u-boot-imx-elnico"

UBOOT_CONFIG ??= "sd"
UBOOT_CONFIG[sd] = "sqm4sx6eb_config,sdcard"

SERIAL_CONSOLE = "115200 ttymxc0"

IMAGE_FSTYPES = "tar.bz2 ext4 sdcard"
```

## conf/machine/sqm4vf6-eb.conf
```bitbake
#@TYPE: Machine
#@NAME: SQM4-VF6 EasyBoard Development Kit
#@SOC: vf60
#@DESCRIPTION: Machine configuration for Elnico SQM4-VF6 EasyBoard Development Kit
#@MAINTAINER: Petr Kubiznak <kubiznak.petr@elnico.cz>

include conf/machine/include/imx-base.inc
include conf/machine/include/tune-cortexa5.inc

SOC_FAMILY = "vf60"

PREFERRED_PROVIDER_virtual/kernel ?= "linux-timesys"
PREFERRED_PROVIDER_u-boot = "u-boot-timesys-elnico"
PREFERRED_PROVIDER_jpeg = "libjpeg-turbo"
PREFERRED_PROVIDER_jpeg-native = "libjpeg-turbo-native"

UBOOT_MACHINE = "sqm4vf6eb_config"

KERNEL_IMAGETYPE = "uImage"
SDCARD_ROOTFS ?= "${DEPLOY_DIR_IMAGE}/${IMAGE_NAME}.rootfs.ext3"
IMAGE_FSTYPES ?= "tar.bz2 ext3 sdcard"

SERIAL_CONSOLE = "115200 ttymxc1"

MACHINE_FEATURES = "apm usbgadget usbhost vfat alsa touchscreen"
```
