/*
 * Copyright (C) 2015 Freescale Semiconductor, Inc.
 *
 * This program is free software; you can redistribute it and/or modify
 * it under the terms of the GNU General Public License version 2 as
 * published by the Free Software Foundation.
 */

#include "sqm4sx6-eb.dtsi"

/ {
	model = "Elnico SQM4-SX6-EasyBoard v3.0";
};
